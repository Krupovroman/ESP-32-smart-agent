// Settings stored in NVS namespace "cfg" (keys <= 15 chars). See docs/design/arch_draft.md §1.7.
//  S(key, type, default_num, default_str, min, max, max_len, flags)
S("ui_lang",     ST_STR, 0,   "ru",                                0, 0,     3,    0)
S("mode",        ST_U8,  0,   NULL,                                0, 1,     0,    0)
S("text_only",   ST_U8,  1,   NULL,                                0, 1,     0,    0)
S("speaker",     ST_U8,  1,   NULL,                                0, 1,     0,    0)   // O4 / S / D "Динамик"
S("face",        ST_U8,  1,   NULL,                                0, 1,     0,    0)   // S "Лицо шара"
S("volume",      ST_U8,  60,  NULL,                                0, 100,   0,    0)
S("spk_boost",   ST_U8,  12,  NULL,                                0, 18,    0,    0)
S("bright",      ST_U8,  80,  NULL,                                5, 100,   0,    0)
S("dim_s",       ST_U16, 60,  NULL,                                0, 3600,  0,    0)
S("ptt_mode",    ST_U8,  0,   NULL,                                0, 1,     0,    0)
S("max_rec_s",   ST_U8,  30,  NULL,                                3, 30,    0,    0)
S("vad_stop",    ST_U8,  0,   NULL,                                0, 1,     0,    0)
S("mic_slot",    ST_U8,  0,   NULL,                                0, 1,     0,    0)
S("mic_shift",   ST_U8,  12,  NULL,                                8, 16,    0,    0)
S("ai_url",      ST_STR, 0,   "https://openrouter.ai/api/v1",      0, 0,     128,  0)
S("ai_key",      ST_STR, 0,   "",                                  0, 0,     200,  ST_SECRET)
S("ai_model",    ST_STR, 0,   "google/gemini-3.5-flash-lite",      0, 0,     96,   0)
S("ai_model_fb", ST_STR, 0,   "google/gemini-3.1-flash-lite",      0, 0,     96,   0)
S("ai_effort",   ST_STR, 0,   "minimal",                           0, 0,     12,   0)
S("ai_stream",   ST_U8,  1,   NULL,                                0, 1,     0,    0)
S("ai_json",     ST_U8,  1,   NULL,                                0, 1,     0,    0)
S("ai_maxtok",   ST_U16, 1024, NULL,                               50, 4000, 0,    0)
S("ai_len",      ST_U8,  1,   NULL,                                0, 2,     0,    0)   // reply length: 0 short, 1 normal, 2 detailed
S("ai_temp",     ST_U8,  40,  NULL,                                0, 200,   0,    0)
S("ai_hist",     ST_U8,  6,   NULL,                                0, 20,    0,    0)
S("ai_web",      ST_U8,  1,   NULL,                                0, 2,     0,    0)   // web search: 0 off, 1 auto, 2 always
S("ai_web_n",    ST_U8,  3,   NULL,                                1, 5,     0,    0)   // web results per search
S("ai_sys",      ST_STR, 0,   "",                                  0, 0,     2000, 0)
S("tts_url",     ST_STR, 0,   "",                                  0, 0,     128,  0)
S("tts_key",     ST_STR, 0,   "",                                  0, 0,     200,  ST_SECRET)
S("tts_model",   ST_STR, 0,   "microsoft/mai-voice-2.1-flash",     0, 0,     96,   0)
S("tts_voice",   ST_STR, 0,   "ru-RU-Masha:MAI-Voice-2.1-Flash",   0, 0,     64,   0)
S("tts_speed",   ST_U8,  100, NULL,                                50, 200,  0,    0)
S("tts_rate",    ST_U32, 0,   NULL,                                0, 48000, 0,    0)
S("stt_mode",    ST_U8,  0,   NULL,                                0, 1,     0,    0)
S("stt_url",     ST_STR, 0,   "",                                  0, 0,     128,  0)
S("stt_key",     ST_STR, 0,   "",                                  0, 0,     200,  ST_SECRET)
S("stt_model",   ST_STR, 0,   "openai/whisper-large-v3-turbo",     0, 0,     96,   0)
S("tr_lang_a",   ST_STR, 0,   "ru",                                0, 0,     8,    0)
S("tr_lang_b",   ST_STR, 0,   "en",                                0, 0,     8,    0)
S("tr_voice_a",  ST_STR, 0,   "ru-RU-Masha:MAI-Voice-2.1-Flash",   0, 0,     64,   0)
S("tr_voice_b",  ST_STR, 0,   "",                                  0, 0,     64,   0)
S("tr_vad",      ST_U8,  1,   NULL,                                0, 1,     0,    0)
S("lcd_inv",     ST_U8,  1,   NULL,                                0, 1,     0,    0)
S("ota_url",     ST_STR, 0,   "",                                  0, 0,     200,  0)
S("bat_vfull",   ST_U16, 4150, NULL,                               4000, 4250, 0,  0)   // battery 100 % (mV), learned
S("dev_flags",   ST_U32, 0,   NULL,                                0, 0x7fffffff, 0, 0)
